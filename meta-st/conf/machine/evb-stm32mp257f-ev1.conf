## meta-st/conf/machine/evb-stm32mp257f-ev1.conf
```bitbake
#@TYPE: Machine
#@NAME: stm32mp25-eval
#@DESCRIPTION: Configuration for all STM32MP25 eval boards (EV)
#@NEEDED_BSPLAYERS: layers/meta-openembedded/meta-oe layers/meta-openembedded/meta-python

# Define specific familly common machine name
MACHINEOVERRIDES =. "stm32mp2common:stm32mp25common:"

include conf/machine/include/st-machine-common-stm32mp.inc
include conf/machine/include/st-machine-providers-stm32mp.inc

# =========================================================================
# Chip architecture
# =========================================================================
DEFAULTTUNE = "cortexa35"
include conf/machine/include/arm/armv8a/tune-cortexa35.inc

# =========================================================================
# boot scheme
# =========================================================================
BOOTSCHEME_LABELS = "optee"

# =========================================================================
# boot device
# =========================================================================
# Define the boot device supported
BOOTDEVICE_LABELS += "emmc"
BOOTDEVICE_LABELS += "nor-sdcard"
BOOTDEVICE_LABELS += "sdcard"

# =========================================================================
# Machine settings
# =========================================================================
# activate external dt
EXTERNAL_DT_ENABLED = "1"

# Define list of devicetree per supported storage
STM32MP_DT_FILES_EMMC   += "stm32mp257f-ev1"
STM32MP_DT_FILES_SDCARD += "stm32mp257f-ev1"
STM32MP_DT_FILES_NOR    += "stm32mp257f-ev1"

EXTERNAL_DEVICETREE_SDCARD = "stm32mp257f-ev1-ca35tdcid-ostl"

EXTERNAL_DEVICETREE_EMMC = "stm32mp257f-ev1-ca35tdcid-ostl"

# =========================================================================
# Machine features
# =========================================================================

# M33
MACHINE_FEATURES += "m33copro"

# PCIe
PCI_LIST += "linux-firmware-rtl8168"

# ==========================================================================
# M33 Boards
# ==========================================================================
# Lists of boards/devicetree on which the m33 service MUST be started
M33_BOARDS_START_AT_STARTUP = "stm32mp257f-ev1"
M33_BOARDS_START_AT_STARTUP =+ "${@bb.utils.contains('EXTERNAL_DT_ENABLED', '1', 'stm32mp257f-ev1-ca35tdcid-ostl', '', d)}"

# =========================================================================
# OPTEE
# =========================================================================
# For sdk generation, declare the default board configuration to use.
ST_OPTEE_EXPORT_TA_REF_BOARD:stm32mp2common = "stm32mp257f-ev1.dts"

# =========================================================================
# WIC for sdcard raw image
# =========================================================================
WIC_CREATE_EXTRA_ARGS = "--no-fstab-update"
WKS_FILE_DEPENDS ?= " \
    virtual/bootloader \
    virtual/trusted-firmware-a \
    virtual-optee-os \
    ${@bb.utils.contains('ST_BOOTFS','1','st-image-bootfs', '', d)} \
"
OPTEE_WIC_FILE = "sdcard-stm32mp257f-ev1-optee-2GB.wks.in"

# for generated a WIC file, please uncomment the 2 following lines or add them to local.conf
#WKS_IMAGE_FSTYPES += "wic wic.bz2 wic.bmap"
#WKS_FILE += "${OPTEE_WIC_FILE}"

require conf/machine/include/obmc-bsp-common.inc

PREFERRED_PROVIDER_virtual/obmc-chassis-mgmt = "packagegroup-obmc-st-apps"
PREFERRED_PROVIDER_virtual/obmc-fan-mgmt = "packagegroup-obmc-st-apps"
PREFERRED_PROVIDER_virtual/obmc-flash-mgmt = "packagegroup-obmc-st-apps"
PREFERRED_PROVIDER_virtual/obmc-system-mgmt = "packagegroup-obmc-st-apps"
PREFERRED_PROVIDER_virtual/obmc-inventory-data ?= "${VIRTUAL-RUNTIME_skeleton_workbook}"
PREFERRED_PROVIDER_virtual/obmc-host-ipmi-hw ?= "phosphor-ipmi-kcs"
PREFERRED_PROVIDER_virtual/phosphor-led-manager-config-native = "stm32mp257f-ev1-led-manager-config-native"

OBMC_MACHINE_FEATURES += "\
        obmc-bmc-state-mgmt \
        obmc-host-ipmi \
        obmc-host-state-mgmt \
        "

# IMAGE_CLASSES:remove = " image_types_phosphor "
IMAGE_FSTYPES:remove =  " mtd-static mtd-static-tar mtd-static-alltar "
KERNEL_CLASSES:remove = " kernel-fitimage "
KERNEL_IMAGETYPES:remove =  "fitImage vmlinux "
```
