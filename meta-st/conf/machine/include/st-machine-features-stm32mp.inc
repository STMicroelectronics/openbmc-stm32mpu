## meta-st/conf/machine/include/st-machine-features-stm32mp.inc
```bitbake
#@DESCRIPTION: Machine features definitions for STM32 systems

# =========================================================================
# optee
# =========================================================================
OPTEE_LIST ?= "\
    virtual-optee-os \
    "
OPTEE_IMAGE_INSTALL = "${@bb.utils.contains('COMBINED_FEATURES', 'optee', '${OPTEE_LIST}', '', d)} "

OPTEE_BINARY ?= "\
    virtual-optee-os \
    "
OPTEE_BINARY_INSTALL = "${@bb.utils.contains('MACHINE_FEATURES', 'optee', '${OPTEE_BINARY}', '', d)} "

# =========================================================================
# pci
# =========================================================================
PCI_LIST ?= ""
PCI_IMAGE_INSTALL = "${@bb.utils.contains('MACHINE_FEATURES', 'pci', '${PCI_LIST}', '', d)} "

# =========================================================================
# Image appends
# =========================================================================
EXTRA_IMAGEDEPENDS:append = " \
    ${OPTEE_BINARY_INSTALL} \
    "

MACHINE_EXTRA_RRECOMMENDS:append = " \
    ${OPTEE_IMAGE_INSTALL}      \
    ${PCI_IMAGE_INSTALL}        \
    "
```

## meta-st/meta-st-stm32mp/conf/layer.conf
```bitbake
# We have a conf and classes directory, add to BBPATH
BBPATH .= ":${LAYERDIR}"

# We have a recipes-* directories, add to BBFILES
BBFILES += "${LAYERDIR}/recipes-*/*/*.bb \
	${LAYERDIR}/recipes-*/*/*.bbappend"

BBFILE_COLLECTIONS += "stm32mp2-layer"
BBFILE_PATTERN_stm32mp2-layer := "^${LAYERDIR}/"
BBFILE_PRIORITY_stm32mp2-layer = "6"

EULA_FILE_ST:stm32mpcommon = "${LAYERDIR}/conf/eula/${MACHINE}"
EULA_FILE_ST_MD5SUM:stm32mpcommon = "1c485682b3ceeae0c296ba593235bd69"

# Set a variable to get the STM32MP BSP location
STM32MP_BASE = "${LAYERDIR}"

# This should only be incremented on significant changes that will
# cause compatibility issues with other layers
LAYERVERSION_stm32mp2-layer = "1"
LAYERSERIES_COMPAT_stm32mp2-layer = "mickledore nanbield"

# for optee-os-stm32mp dependency
LAYERDEPENDS_stm32mp2-layer = "core openembedded-layer meta-python"
```

## meta-st/meta-st-stm32mp/conf/machine/stm32mp2.conf
```bitbake
#@TYPE: Machine
#@NAME: stm32mp2
#@DESCRIPTION: Configuration for all STM32MP2 boards (EV, DK, ...)
#@NEEDED_BSPLAYERS: layers/meta-openembedded/meta-oe layers/meta-openembedded/meta-python

# Define specific familly common machine name
MACHINEOVERRIDES =. "stm32mp2common:stm32mp25common:"

include conf/machine/include/st-machine-common-stm32mp.inc
include conf/machine/include/st-machine-providers-stm32mp.inc

# =========================================================================
# Chip architecture
# =========================================================================
DEFAULTTUNE = "cortexa35"
include conf/machine/include/arm/armv8a/tune-cortexa35.inc

# =========================================================================
# boot scheme
# =========================================================================
BOOTSCHEME_LABELS = "optee"
BOOTSCHEME_LABELS += "fastboot"

# =========================================================================
# OPTEE profile
# =========================================================================
# Optee profile, permit to activate or desactvate a list of service on optee.
# There is two configuration available:
#  - secure_and_system_services aka optee boot scheme
#  - system_services aka opteemin boot scheme

# Default optee profile use by all soc, (if exception see if there is a specific
# profile for a soc)
ST_OPTEE_PROFILE ?= "secure_and_system_services"
ST_OPTEE_EXPORT_TA_REF_BOARD:stm32mp2common = "stm32mp257f-dk.dts"
# =========================================================================
# boot device
# =========================================================================
# Define the boot device supported
BOOTDEVICE_LABELS += "emmc"
#BOOTDEVICE_LABELS += "nand-4-256-1024"
BOOTDEVICE_LABELS += "nor-sdcard"
BOOTDEVICE_LABELS += "sdcard"

# =========================================================================
# Machine settings
# =========================================================================
# Define list of devicetree per supported storage
STM32MP_DT_FILES_EMMC   += "stm32mp257f-dk"
STM32MP_DT_FILES_SDCARD += "stm32mp257f-dk"

STM32MP_DT_FILES_EMMC   += "stm32mp257f-ev1"
STM32MP_DT_FILES_SDCARD += "stm32mp257f-ev1"
STM32MP_DT_FILES_NOR    += "stm32mp257f-ev1"

EXTERNAL_DEVICETREE_SDCARD = "stm32mp257f-dk-ca35tdcid-ostl"
EXTERNAL_DEVICETREE_SDCARD =+ "stm32mp257f-dk-ca35tdcid-ostl-m33-examples"
EXTERNAL_DEVICETREE_SDCARD =+ "stm32mp257f-ev1-ca35tdcid-ostl"
EXTERNAL_DEVICETREE_SDCARD =+ "stm32mp257f-ev1-ca35tdcid-ostl-m33-examples"

EXTERNAL_DEVICETREE_EMMC = "stm32mp257f-dk-ca35tdcid-ostl"
EXTERNAL_DEVICETREE_EMMC =+ "stm32mp257f-dk-ca35tdcid-ostl-m33-examples"
EXTERNAL_DEVICETREE_EMMC =+ "stm32mp257f-ev1-ca35tdcid-ostl"
EXTERNAL_DEVICETREE_EMMC =+ "stm32mp257f-ev1-ca35tdcid-ostl-m33-examples"

# =========================================================================
# Machine features
# =========================================================================
MACHINE_FEATURES += "splashscreen"
MACHINE_FEATURES += "watchdog"
MACHINE_FEATURES += "bluetooth"
MACHINE_FEATURES += "wifi"

# GPU
MACHINE_FEATURES += "${@'gpu' if d.getVar('ACCEPT_EULA_'+d.getVar('MACHINE')) == '1' else ''}"
MACHINE_FEATURES += "${@'openvx' if d.getVar('ACCEPT_EULA_'+d.getVar('MACHINE')) == '1' else ''}"
MACHINE_FEATURES += "${@'opencl' if d.getVar('ACCEPT_EULA_'+d.getVar('MACHINE')) == '1' else ''}"
MACHINE_FEATURES += "${@'vulkan' if d.getVar('ACCEPT_EULA_'+d.getVar('MACHINE')) == '1' else ''}"

# M33
MACHINE_FEATURES += "m33copro"

# Bluetooth
BLUETOOTH_LIST += "linux-firmware-bluetooth-bcm4343"
# Wifi
WIFI_LIST += "linux-firmware-bcm43439"
# PCIe
PCI_LIST += "linux-firmware-rtl8168"

# activate external dt
EXTERNAL_DT_ENABLED = "1"

# ==========================================================================
# M33 Boards
# ==========================================================================
# Lists of boards/devicetree on which the m33 service MUST be started
M33_BOARDS_START_AT_STARTUP = "stm32mp257f-dk stm32mp257f-ev1"
M33_BOARDS_START_AT_STARTUP =+ "${@bb.utils.contains('EXTERNAL_DT_ENABLED', '1', 'stm32mp257f-dk-ca35tdcid-ostl', '', d)}"
M33_BOARDS_START_AT_STARTUP =+ "${@bb.utils.contains('EXTERNAL_DT_ENABLED', '1', 'stm32mp257f-ev1-ca35tdcid-ostl', '', d)}"

# ==========================================================================
# FIT specific
# ==========================================================================

# to use FIT image for kernel and devicetree
# MACHINE_FEATURES += "fit"
# #signing key
# UBOOT_SIGN_KEYDIR = "${DEPLOY_DIR_IMAGE}"
# UBOOT_SIGN_KEYNAME = "my-uboot-sign-key"
# # Sign FIT image
# UBOOT_SIGN_ENABLE = "1"
# # generate new signing key if not exist
# FIT_GENERATE_KEYS = "1"
# # Uboot mkimage option
# UBOOT_MKIMAGE_DTCOPTS = "-I dts -O dtb -p 2000"

# ==========================================================================
# OpenBMC specific
# ==========================================================================
require conf/machine/include/obmc-bsp-common.inc

PREFERRED_PROVIDER_virtual/obmc-chassis-mgmt = "packagegroup-obmc-st-apps"
PREFERRED_PROVIDER_virtual/obmc-fan-mgmt = "packagegroup-obmc-st-apps"
PREFERRED_PROVIDER_virtual/obmc-flash-mgmt = "packagegroup-obmc-st-apps"
PREFERRED_PROVIDER_virtual/obmc-system-mgmt = "packagegroup-obmc-st-apps"
PREFERRED_PROVIDER_virtual/obmc-inventory-data ?= "${VIRTUAL-RUNTIME_skeleton_workbook}"
PREFERRED_PROVIDER_virtual/obmc-host-ipmi-hw ?= "phosphor-ipmi-kcs"

OBMC_MACHINE_FEATURES += "\
        obmc-bmc-state-mgmt \
        obmc-host-ipmi \
        obmc-host-state-mgmt \
        "

IMAGE_CLASSES:remove = " image_types_phosphor "
IMAGE_FSTYPES:remove =  " mtd-static mtd-static-tar mtd-static-alltar "
KERNEL_CLASSES:remove = " kernel-fitimage "
KERNEL_IMAGETYPES:remove =  "fitImage vmlinux "
```
